/* Software: monitoring of electrical energy generated by solar panels
 *           using SigFox as wireless comunnication
 * Author: Pedro Bertoleti
 */
#include <SoftwareSerial.h>
#include <Adafruit_INA219.h> 

/* General definitions */
#define REDFOX_BUTTON_PRESSED       0x01
#define REDFOX_BUTTON_NOT_PRESSED   0x00

/* Definition - breathing light time (on and off) */
#define TIME_BREATHING_LIGHT_ON_OFF     500 //ms

/* Uncomment the following line to enable INA219 debug messages */
#define ENABLE_INA219_DEBUG

/* Definitions - AT commands for HT32SX SiP */
#define CMD_AT_HT32SX_RESET         "AT+RESET;"
#define CMD_AT_HT32SX_RCZ2          "AT+CFGRCZ=2;"
#define CMD_AT_HT32SX_SEND_BYTES    "AT+SEND=0:" /* no downlink messages will be checked */

/* Definition - time between two SigFox messages */
#define TIME_BETWEEN_TWO_SIGFOX_MESSAGES         1800000 /* 1800000ms = 30 minutes */

/* Definitions - Arduino Nano V3 GPIOs used for software serial (TX, RX) 
                 and GPIO to make a hardware reset in HT32SX SiP */
#define RESET  4   /* GPIO for making hardware reset in HT32SX */
#define TX     2   /* Serial TX (Nano -> HT32SX) */
#define RX     3   /* Serial RX (Nano <- HT32SX) */

/* Definitions - Arduino Nano V3 GPIOs used for Arduino LED and
                 RedFox button (which reesets the total electrical
                 generated value)
*/
#define LED    13 
#define SW1    5 

/* Definition - time used in button debouncing routine */
#define TIME_BUTTON_DEBOUNCE     250 //ms

/* Definitions - hardware and software serial baudrates */
#define BAUDRATE_SERIAL_DEBUG     115200  /* Hardware UART */
#define BAUDRATE_SERIAL_HT32SX    9600   /* Software UART */

/* Definition - INA219 I²C address */
#define INA219_I2C_ADDR               0x40

/* Object for controlling software serial (to communicate 
   Arduino Nano and HT32SX) */
SoftwareSerial serial_HT32SX(RX, TX);

/* Object for controlling INA219 module */
Adafruit_INA219 ina219(INA219_I2C_ADDR);

/* Global variables */
unsigned long timestamp_electrical_energy_measurement;
unsigned long timestamp_sigfox_message_send;
unsigned long timestamp_breathing_light;
float total_electrical_energy_generated_kwh = 0.0;
float instant_voltage_generated_V = 0.0;
float instant_current_generated_mA = 0.0;
bool is_nano_board_led_on = false;
char at_command_string[50] = {0};

/* Function protypes */
void hardware_reset_HT32SX(void);
void  send_AT_command_HT32SX(char * pt_command);
unsigned long time_difference_ms(unsigned long tref);
char verify_if_RedFox_button_is_pressed(int button_gpio);

/* Function: hardware resets the HT32SX SiP
 * Params: none
 * Return: none
 */
void hardware_reset_HT32SX(void) 
{
    digitalWrite(RESET, HIGH);
    delay(1000);
    digitalWrite(RESET, LOW);
    delay(100);    
}

/* Function: send AT command to HT32SX SiP
 * Params: pointer to the AT command string
 * Return: none
 */
void  send_AT_command_HT32SX(char * pt_command)
{
    char cmd_buffer[50] = {0};
    memcpy(cmd_buffer, pt_command, strlen(pt_command));
    serial_HT32SX.write(cmd_buffer, strlen(cmd_buffer));
    serial_HT32SX.flush();
}

/* Function: determines the difference between a given timestamp and current timestamp,
 *           considering timestamp is the time since microcontroller has been powered on.
 * Params: timestamp (reference)
 * Return: diferença de tempo calculada
 */
unsigned long time_difference_ms(unsigned long tref)
{
    return (millis() - tref);
}

/* Function: checks if ReFox button is pressed or not (considering debounce routines)
 * Params: button GPIO
 * Return: REDFOX_BUTTON_PRESSED or REDFOX_BUTTON_NOT_PRESSED
 */
char verify_if_RedFox_button_is_pressed(int button_gpio)
{
    char button_status = REDFOX_BUTTON_NOT_PRESSED;

    if (digitalRead(button_gpio) == LOW)
    {
        /* Confirms RedFox button has been pressed */
        delay(TIME_BUTTON_DEBOUNCE);
        if (digitalRead(button_gpio) == LOW)
        {
            button_status = REDFOX_BUTTON_PRESSED;
        }
    }

    return button_status;
}

void setup() 
{
    /* Init serial communications (for both hardware and software serial) */
    Serial.begin(BAUDRATE_SERIAL_DEBUG);
    serial_HT32SX.begin(BAUDRATE_SERIAL_HT32SX);
    Serial.println("Monitoring of electrical energy generated by solar panels");

    /* Init GPIOs */
    pinMode(RESET, OUTPUT);
    digitalWrite(RESET, HIGH);
    pinMode(LED, OUTPUT);
    digitalWrite(LED, LOW);
    pinMode(SW1, INPUT_PULLUP);

    /* Init INA219 module I²C communication */
    ina219.begin();

    /* Hardware reset HT32SX SiP and configures RCZ2 SigFox zone
       (preparing SigFox communication to work in Brazil, Canada, 
       Mexico, Puerto Rico and USA countries) */
    hardware_reset_HT32SX();
    delay(8000);
    send_AT_command_HT32SX(CMD_AT_HT32SX_RCZ2);    

    /* Init all timestamp references */
    timestamp_electrical_energy_measurement = millis();
    timestamp_sigfox_message_send = millis();
    timestamp_breathing_light = millis();
}

void loop() 
{
    char c;        
    unsigned char instant_voltage_byte;
    short instant_current_bytes;
    float instant_power_kW;
    float shunt_voltage;
    
    /* Echo everything is received in HT32SX software serial to debug serial (hardware serial) */
    if (serial_HT32SX.available()) 
    {
        c = serial_HT32SX.read(); 
        Serial.print(c);
    }

    /* Turn breathing light on and off */
    if (time_difference_ms(timestamp_breathing_light) >= TIME_BREATHING_LIGHT_ON_OFF)
    {
        if (is_nano_board_led_on == false)
        {
            digitalWrite(LED, HIGH);
            is_nano_board_led_on = true;
        }
        else
        {
            digitalWrite(LED, LOW);
            is_nano_board_led_on = false;
        }
        
        timestamp_breathing_light = millis();
    }

    /* Check if RedFox board button is pressed or not. 
       If this button is pressed, then the total amount of generated electrical energy  
       is reseted. */
    if (verify_if_RedFox_button_is_pressed(SW1) == REDFOX_BUTTON_PRESSED)
    {
        total_electrical_energy_generated_kwh = 0.0;
        Serial.println("[ALERT] Total amount of generated electrical energy has been reseted.");     
    }

    /* Measure every second the instant voltage, instant current and instant power. 
       Also, calculates every second the amount of generated electrical energy */
    if (time_difference_ms(timestamp_electrical_energy_measurement) >= 1000)
    {
        shunt_voltage = ina219.getShuntVoltage_mV()/1000.0;
        instant_voltage_generated_V = ina219.getBusVoltage_V() + shunt_voltage;        
        instant_current_generated_mA = ina219.getCurrent_mA();
        instant_power_kW = (instant_voltage_generated_V*instant_current_generated_mA*0.001)*0.001;
        total_electrical_energy_generated_kwh = total_electrical_energy_generated_kwh + 
                                   instant_power_kW/3600.0;
        
        #ifdef ENABLE_INA219_DEBUG
            Serial.print("Shunt resistor voltage: ");
            Serial.println(shunt_voltage);
            Serial.print("Load voltage: ");
            Serial.print(instant_voltage_generated_V);
            Serial.println("V");
            Serial.print("Instant current: ");
            Serial.print(instant_current_generated_mA);
            Serial.println("mA");
            Serial.print("Instant power: ");
            Serial.print(instant_power_kW);
            Serial.println("kW");
            Serial.print("Total of generated electrical energy: ");
            Serial.print(total_electrical_energy_generated_kwh);
            Serial.println("kWh");            
        #endif 
        
        timestamp_electrical_energy_measurement = millis();
    }

    /* Checks if it's time to send a SigFox message containing all measurements */
    if (time_difference_ms(timestamp_sigfox_message_send) >= TIME_BETWEEN_TWO_SIGFOX_MESSAGES)
    {
        Serial.print("Total of generated electrical energy: ");
        Serial.print(total_electrical_energy_generated_kwh);
        Serial.println("kWh");

        /* Instant voltage and instant current are truncated to 1 byte and 2 bytes values
           (in order to save space among bytes to be send via SigFox) */
        instant_voltage_byte = (unsigned char)(instant_voltage_generated_V*10.0);
        instant_current_bytes = (short)(instant_current_generated_mA*10.0);      

        /* Formats AT command string and sends it via UART to HT32SX SiP */
        sprintf(at_command_string, "%s%08lx%02x%04x;", CMD_AT_HT32SX_SEND_BYTES, 
                                                       total_electrical_energy_generated_kwh,
                                                       instant_voltage_byte,
                                                       instant_current_bytes);

        Serial.print("AT command: ");
        Serial.println(at_command_string);

        /* Sends AT command to HT32SX SiP*/
        send_AT_command_HT32SX(at_command_string);
        timestamp_sigfox_message_send = millis();
    }
}
